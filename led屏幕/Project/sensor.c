#include "hal_defs.h"
#include "hal_cc8051.h"
#include "hal_int.h"
#include "hal_mcu.h"
#include "hal_board.h"
#include "hal_led.h"
#include "hal_rf.h"
#include "basic_rf.h"
#include "hal_uart.h" 
#include "UART_PRINT.h" 
#include "TIMER.h"
#include "get_adc.h"
#include "sh10.h"
#include <string.h>

#define MAX_SEND_BUF_LEN  128  
#define MAX_RECV_BUF_LEN  128
static uint8 pTxData[MAX_SEND_BUF_LEN]; //定义无线发送缓冲区的大小
static uint8 pRxData[MAX_RECV_BUF_LEN]; //定义无线接收缓冲区的大小

#define MAX_UART_SEND_BUF_LEN  128
#define MAX_UART_RECV_BUF_LEN  128
uint8 uTxData[MAX_UART_SEND_BUF_LEN]; //定义串口发送缓冲区的大小
uint8 uRxData[MAX_UART_RECV_BUF_LEN]; //定义串口接收缓冲区的大小
uint16 uTxlen = 0;
uint16 uRxlen = 0;

uint8 LEDData[288]=
{0xAA,0xFF,0xBB,0x52,0x43,0xAA,0xFF,0xBB,0x53,0x44,0x20,0x00,0x00,0x01,0x00,0x00,
0x00,0x20,0x20,0x20,0x20,0x20,0x20,0x20,0x20,0x20,0x20,0xFF,0x00,0x00,0x00,0x00,
0x00,0x00,0x00,0x00,0x00,0x00,0x00,0x00,0x00,0x00,0x00,0x00,0x00,0x00,0x00,0x00,
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0x00,0x00,0x00,0x00,0x00,0x00,0x00,0x00,0x00,0x00,0x00,0x00,0x00,0xFE,0xFF,0xFF};




/*****点对点通讯地址设置******/
#define RF_CHANNEL                20           // 频道 11~26
#define PAN_ID                    0x0202      //网络id 
#define MY_ADDR                   0x1203      // 本机模块地址
#define SEND_ADDR                 0x1204   //发送地址
/**************************************************/
static basicRfCfg_t basicRfConfig;
uint8   APP_SEND_DATA_FLAG;
/******************************************/

/**************************************************/
// 无线RF初始化
void ConfigRf_Init(void)
{
    basicRfConfig.panId       =   PAN_ID;        //zigbee的ID号设置
    basicRfConfig.channel     =   RF_CHANNEL;    //zigbee的频道设置
    basicRfConfig.myAddr      =  MY_ADDR;   //设置本机地址
    basicRfConfig.ackRequest  =   TRUE;          //应答信号
    while(basicRfInit(&basicRfConfig) == FAILED); //检测zigbee的参数是否配置成功
    basicRfReceiveOn();                // 打开RF
}

void SendData2LED(void)
{
  halUartWrite(&LEDData[0],5);
  halMcuWaitMs(30);
  halUartWrite(&LEDData[5],5);
  halMcuWaitMs(30);
  for(int i=0;i<34;i++)
  {
    halUartWrite(&LEDData[10+i*8],8);
    halMcuWaitMs(30);
  }
  halUartWrite(&LEDData[282],3);
  halMcuWaitMs(50);
  halUartWrite(&LEDData[285],3);
  halMcuWaitMs(30);
}

void DataConver(uint8 *buf, uint16 len)
{
   uint8 sum1;
   sum1=0x00;
   int len1=len; //需测试发送字符个数
   for(int i=10;i<200;i++)
   {
    LEDData[i]=0x00;
   }
   for(int j=0;j<(len1/10);j++)
   {  
      LEDData[13+j*14+0]=0x01;
      LEDData[13+j*14+1]=0x00;
      LEDData[13+j*14+2]=0x00;
      LEDData[13+j*14+3]=0x00;
      for(int i=0;i<10;i++)
      {
        LEDData[17+j*14+i]=*buf++;
      }
   }
   
   LEDData[13+(len1/10)*14+0]=0x01;
   LEDData[13+(len1/10)*14+1]=0x00;
   LEDData[13+(len1/10)*14+2]=0x00;
   LEDData[13+(len1/10)*14+3]=0x00;
   for(int i=0;i<(len1%10);i++)
   {
      LEDData[17+(len1/10)*14+i]=*buf++;
   }
   
   for(int i=0;i<(10-len1%10);i++)
   {
      LEDData[17+(len1/10)*14+(len1%10)+i]=0x20;
   }
   
   LEDData[17+(len1/10)*14+10]=0xFF;
   
   for(int i=0;i<((len1/10)*14+10);i++)
   {
    sum1=sum1+LEDData[17+i];
   }
   
  LEDData[10]=sum1;
}
/********************MAIN************************/
void main(void)    
{   uint16 sensor_val,sensor_tem;
    uint16  len = 0;
    halBoardInit();  //模块相关资源的初始化
    ConfigRf_Init(); //无线收发参数的配置初始化 
    halLedSet(1);
    halLedSet(2);  
    Timer4_Init(); //定时器初始化
    //Timer4_On();  //打开定时器
        
    while(1)
    {   
        if(basicRfPacketIsReady())   //查询有没收到无线信号
        {
            halLedToggle(4);   // 红灯取反，无线接收指示
            //接收无线数据
            len = basicRfReceive(pRxData, MAX_RECV_BUF_LEN, NULL);
            //接收到的无线发送到串口数
            DataConver(pRxData,len);
            SendData2LED();
            halMcuWaitMs(30);
            SendData2LED();
        } 
      
    }
}
/************************main end ****************************/